## sdkconfig.defaults
```kconfig
# Keep the HUB75 component in "no GFX" mode (pure ESP-IDF).
# If enabled, it expects Arduino + Adafruit-GFX components.
CONFIG_ESP32_HUB75_USE_GFX=n

# Match `adafruit_feather_esp32_v2` (8MB flash) and the reused `8m4m.csv`.
CONFIG_ESPTOOLPY_FLASHSIZE_8MB=y

# ESP32-S3 runtime headroom: LVGL + Wi-Fi + PSRAM + HUB75 refresh is safer at 240MHz.
CONFIG_ESP_DEFAULT_CPU_FREQ_MHZ_240=y
CONFIG_ESP_DEFAULT_CPU_FREQ_MHZ=240

# LVGL (built from components/lvgl)
CONFIG_LV_USE_DEMO_BENCHMARK=n
CONFIG_LV_USE_DEMO_WIDGETS=n
CONFIG_LV_USE_DEMO_STRESS=n
CONFIG_LV_USE_DEMO_MUSIC=n
CONFIG_LV_BUILD_EXAMPLES=n
CONFIG_LV_MEM_SIZE_KILOBYTES=48

# Task watchdog - 延长超时时间以允许字体加载
CONFIG_ESP_TASK_WDT_TIMEOUT_S=10
CONFIG_ESP_TASK_WDT_CHECK_IDLE_TASK_CPU0=n
CONFIG_ESP_TASK_WDT_CHECK_IDLE_TASK_CPU1=n
CONFIG_ESP_INT_WDT_TIMEOUT_MS=800
# --- LVGL cache (improves stability for repeated PNG decode/draw) ---
# Keep a small LRU cache for decoded images to avoid frequent malloc/free that can
# fragment heap and eventually make PNG decode fail during long runs.
CONFIG_LV_CACHE_DEF_SIZE=0
# Cache a few image headers too (reduces file IO and decoder header parsing).
CONFIG_LV_IMAGE_HEADER_CACHE_DEF_CNT=0

# mbedTLS content buffers (reduce TLS handshake/runtime peak RAM)
CONFIG_MBEDTLS_SSL_IN_CONTENT_LEN=16384
CONFIG_MBEDTLS_SSL_OUT_CONTENT_LEN=4096
CONFIG_MBEDTLS_EXTERNAL_MEM_ALLOC=y
# CONFIG_MBEDTLS_DYNAMIC_BUFFER is not set
CONFIG_SPIRAM_TRY_ALLOCATE_WIFI_LWIP=y
CONFIG_LV_USE_FS_STDIO=y
CONFIG_LV_FS_STDIO_LETTER=83
CONFIG_LV_FS_STDIO_PATH=""
CONFIG_LV_FS_STDIO_CACHE_SIZE=0
CONFIG_LV_USE_LODEPNG=y
CONFIG_LV_USE_TJPGD=y
```
